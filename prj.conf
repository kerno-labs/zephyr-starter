## CMakeLists.txt
```
cmake_minimum_required(VERSION 3.20.0)

find_package(Zephyr REQUIRED HINTS $ENV{ZEPHYR_BASE})
project(zephyr_starter)

list(APPEND CMAKE_MODULE_PATH ${ZEPHYR_BASE}/modules/nanopb)
include(nanopb)

target_include_directories(app PRIVATE include)
target_sources(app PRIVATE
  src/main.c
  src/wifi.c
  src/telemetry/mcu_temperature.c
  src/telemetry/imu.c
  src/time_service.c
  src/mqtt_uploader.c
)
zephyr_nanopb_sources(app proto/telemetry.proto)

# app.local.conf 提供相对路径。CA 证书在构建时嵌入固件；
# 裸机运行时不存在可读取的本地文件路径。
if(DEFINED EXTRA_CONF_FILE AND EXISTS "${EXTRA_CONF_FILE}")
  file(STRINGS "${EXTRA_CONF_FILE}" app_ca_line REGEX "^CONFIG_APP_MQTT_CA_CERT_PATH=\"")
  if(app_ca_line MATCHES "^CONFIG_APP_MQTT_CA_CERT_PATH=\"([^\"]+)\"")
    set(app_ca_file "${CMAKE_CURRENT_SOURCE_DIR}/${CMAKE_MATCH_1}")
    if(EXISTS "${app_ca_file}")
      generate_inc_file_for_target(app "${app_ca_file}" "${CMAKE_CURRENT_BINARY_DIR}/app_ca_cert.inc")
      target_compile_definitions(app PRIVATE APP_HAS_CA_CERT=1)
    else()
      message(FATAL_ERROR "CONFIG_APP_MQTT_CA_CERT_PATH does not exist: ${app_ca_file}")
    endif()
  endif()
endif()
```

## Kconfig
```
# 应用自身的部署与遥测策略配置。
mainmenu "CoreS3 Raw MQTT telemetry"

config APP_MQTT_ENABLED
	bool "Enable MQTT publishing"
	default n

config APP_WIFI_SSID
	string "Wi-Fi SSID"
	default ""

config APP_WIFI_PSK
	string "Wi-Fi passphrase"
	default ""

config APP_MQTT_HOST
	string "MQTT broker hostname"
	default ""

config APP_MQTT_PORT
	int "MQTTS broker port"
	default 8883
	range 1 65535

config APP_MQTT_USERNAME
	string "MQTT username"
	default ""

config APP_MQTT_PASSWORD
	string "MQTT password"
	default ""

config APP_MQTT_CA_CERT_PATH
	string "CA certificate path (relative to application root)"
	default ""

config APP_DEVICE_NAME
	string "Device name used in the MQTT topic"
	default "cores3-001"

config APP_TEMPERATURE_SAMPLE_INTERVAL_S
	int "CPU temperature sample interval in seconds"
	default 300
	range 1 86400

config APP_TEMPERATURE_BATCH_SIZE
	int "CPU temperature samples per upload batch"
	default 6
	range 1 60

config APP_IMU_SAMPLE_INTERVAL_S
	int "IMU sample interval in seconds"
	default 10
	range 1 86400

config APP_IMU_BATCH_SIZE
	int "IMU samples per upload batch"
	default 60
	range 1 120

config APP_MQTT_QUEUE_DEPTH
	int "Complete batch send queue depth"
	default 4
	range 1 32

config APP_MQTT_BUFFER_SIZE
	int "MQTT and encoded protobuf buffer size"
	default 2048
	range 512 8192

source "Kconfig.zephyr"
```

## prj.conf
```kconfig
# 启用控制台设备支持。
CONFIG_CONSOLE=y
# 启用串口驱动支持，供控制台和 Shell 使用。
CONFIG_SERIAL=y
# 启用 Zephyr 日志子系统。
CONFIG_LOG=y
# 采用延迟模式输出日志，降低实时路径的阻塞。
CONFIG_LOG_MODE_DEFERRED=y
# 应用自身的编译告警不升级为错误；第三方模块仍可能保留其独立策略。
CONFIG_COMPILER_WARNINGS_AS_ERRORS=n
# 将主线程栈空间设为 4096 字节。
CONFIG_MAIN_STACK_SIZE=4096
# 将系统工作队列栈空间设为 4096 字节。
CONFIG_SYSTEM_WORKQUEUE_STACK_SIZE=4096

# 支持解析 RSA 类型的证书公钥。
CONFIG_PSA_WANT_KEY_TYPE_RSA_PUBLIC_KEY=y
# 支持 RSA PKCS#1 v1.5 签名算法。
CONFIG_PSA_WANT_ALG_RSA_PKCS1V15_SIGN=y

# 启用传感器子系统。
CONFIG_SENSOR=y
# 启用 nanopb Protocol Buffers 编解码支持。
CONFIG_NANOPB=y
# 启用 ESP32 内置温度传感器驱动。
CONFIG_ESP32_TEMP=y
# 启用 RTC 子系统。
CONFIG_RTC=y
# 启用 PCF8563 实时时钟驱动。
CONFIG_RTC_PCF8563=y

# 启用 Zephyr 网络协议栈。
CONFIG_NETWORKING=y
# 启用 IPv4 协议支持。
CONFIG_NET_IPV4=y
# 启用 IPv4 DHCP 客户端自动获取地址。
CONFIG_NET_DHCPV4=y
# 启用 TCP 协议支持。
CONFIG_NET_TCP=y
# 启用 BSD Socket API。
CONFIG_NET_SOCKETS=y
# 启用 DNS 域名解析器。
CONFIG_DNS_RESOLVER=y
# 启用 Wi-Fi 二层网络管理接口。
CONFIG_NET_L2_WIFI_MGMT=y
# 启用通用 Wi-Fi 支持。
CONFIG_WIFI=y
# 启用 ESP32 Wi-Fi 驱动。
CONFIG_WIFI_ESP32=y
# 本机未安装 Espressif Wi-Fi blobs 时只用于编译验证；实板联网必须删除。
CONFIG_BUILD_ONLY_NO_BLOBS=y

# 启用 MQTT 客户端库。
CONFIG_MQTT_LIB=y
# 为 MQTT 客户端启用 TLS 支持。
CONFIG_MQTT_LIB_TLS=y
# 允许通过 Socket 选项配置 TLS。
CONFIG_NET_SOCKETS_SOCKOPT_TLS=y
# 启用 mbedTLS 加密库。
CONFIG_MBEDTLS=y
# 允许 mbedTLS 使用动态堆内存。
CONFIG_MBEDTLS_ENABLE_HEAP=y
# 为 mbedTLS 分配 40000 字节堆空间。
CONFIG_MBEDTLS_HEAP_SIZE=40000
# 启用 mbedTLS 通用消息摘要模块。
CONFIG_MBEDTLS_MD_C=y
# 启用 SHA-256 算法。
CONFIG_PSA_WANT_ALG_SHA_256=y
# 支持解析 PEM 格式证书。
CONFIG_MBEDTLS_PEM_PARSE_C=y
# 支持解析 X.509 证书。
CONFIG_MBEDTLS_X509_CRT_PARSE_C=y
# TLS 握手中使用 Broker 主机名作为 SNI。
CONFIG_MBEDTLS_SSL_SERVER_NAME_INDICATION=y
# 启用 TLS 1.2 ECDHE-RSA-AES128-GCM-SHA256 加密套件。
CONFIG_MBEDTLS_CIPHERSUITE_TLS_ECDHE_RSA_WITH_AES_128_GCM_SHA256=y
# 为 TLS 和随机 MQTT 消息 ID 提供熵源。
CONFIG_ENTROPY_GENERATOR=y

# 启用交互式 Shell。
CONFIG_SHELL=y
# 将 Shell 后端绑定到串口。
CONFIG_SHELL_BACKEND_SERIAL=y
# 将 Shell 线程栈空间设为 2048 字节。
CONFIG_SHELL_STACK_SIZE=2048
```

## boards/m5stack_cores3_procpu.overlay
```dts
&wifi { status = "okay"; };
&coretemp { status = "okay"; };
```

## src/main.c
```c
/* 应用入口：按依赖顺序启动独立子系统。 */
#include "mqtt_uploader.h"
#include "wifi.h"
#include "telemetry/register.h"

int main(void)
{
	/* 先初始化 MQTT，再允许 Wi-Fi 上报已获得地址。 */
	mqtt_uploader_init();
	wifi_start();
	telemetry_temperature_register();
	telemetry_imu_register();
	return 0;
}
```

## include/mqtt_uploader.h
```c
#pragma once
#include <stdbool.h>
#include <stddef.h>
#include <stdint.h>
/* 构造设备专属 MQTT topic 并初始化上传模块状态。 */
void mqtt_uploader_init(void);
/* 通知上传模块 DHCP 网络是否已可用。 */
void mqtt_uploader_set_network_ready(bool ready);
/* 将一条完整 protobuf 批次入队；返回 errno 风格结果。 */
int mqtt_uploader_enqueue(const uint8_t *data, size_t length);
```

## include/network.h
```c
#pragma once

/* 注册 Wi-Fi 事件并请求连接已配置的 Wi-Fi。 */
void network_start(void);
```

## include/telemetry.h
```c
#pragma once

#include <stddef.h>
#include <stdint.h>

/* 批大小来自 Kconfig，同时决定 nanopb 生成静态数组的容量。 */
#define TELEMETRY_TEMPERATURE_SAMPLES CONFIG_APP_TEMPERATURE_BATCH_SIZE
#define TELEMETRY_IMU_SAMPLES CONFIG_APP_IMU_BATCH_SIZE
```

## include/time_service.h
```c
#pragma once
#include <stdbool.h>
#include <stdint.h>
/* 读取已校时的 PCF8563 UTC 时间，返回 Unix 毫秒。 */
bool time_service_get_ms(uint64_t *time_ms);
/* 使用 Unix 秒设置 PCF8563 UTC 时间。 */
int time_service_set_unix_seconds(int64_t seconds);
```

## src/mqtt_uploader.c
```c
/* Zephyr MQTT client、MQTTS 生命周期、QoS 1 与重试队列的唯一所有者。 */
#include "mqtt_uploader.h"

#include <errno.h>
#include <string.h>
#include <zephyr/kernel.h>
#include <zephyr/logging/log.h>
#include <zephyr/net/mqtt.h>
#include <zephyr/net/socket.h>
#include <zephyr/net/net_ip.h>
#include <zephyr/net/tls_credentials.h>
#include <zephyr/sys/util.h>

LOG_MODULE_REGISTER(mqtt_uploader, LOG_LEVEL_INF);

struct outbound_message {
	size_t length;
	uint8_t data[CONFIG_APP_MQTT_BUFFER_SIZE];
};

K_MSGQ_DEFINE(outbound_queue, sizeof(struct outbound_message), CONFIG_APP_MQTT_QUEUE_DEPTH, 4);
K_SEM_DEFINE(network_changed, 0, 1);

static volatile bool network_ready;
static bool connected;
static bool puback_received;
static struct mqtt_client client;
static uint8_t rx_buffer[CONFIG_APP_MQTT_BUFFER_SIZE];
static uint8_t tx_buffer[CONFIG_APP_MQTT_BUFFER_SIZE];
static struct sockaddr_storage broker;
static uint16_t packet_id = 1;
static char topic[128];

#ifdef APP_HAS_CA_CERT
static const uint8_t ca_certificate[] = {
#include "app_ca_cert.inc"
};
#define APP_CA_CERT_TAG 1
static sec_tag_t sec_tags[] = { APP_CA_CERT_TAG };
#endif

static void mqtt_event(struct mqtt_client *c, const struct mqtt_evt *evt)
{
	/* 将 MQTT 库事件转换为 mqtt_thread 使用的少量状态。 */
	ARG_UNUSED(c);
	switch (evt->type) {
	case MQTT_EVT_CONNACK:
		connected = evt->result == 0;
		if (!connected) {
			LOG_WRN("MQTT connection refused: %d", evt->result);
		}
		break;
	case MQTT_EVT_DISCONNECT:
		connected = false;
		break;
	case MQTT_EVT_PUBACK:
		if (evt->result == 0) {
			puback_received = true;
		}
		break;
	default:
		break;
	}
}

static int resolve_broker(void)
{
	/* 仅在 DHCP 已使网络可用后，解析配置的 Broker 主机名。 */
	struct zsock_addrinfo hints = { .ai_family = AF_INET, .ai_socktype = SOCK_STREAM };
	struct zsock_addrinfo *result;
	char port[6];
	int rc;

	snprintk(port, sizeof(port), "%d", CONFIG_APP_MQTT_PORT);
	rc = zsock_getaddrinfo(CONFIG_APP_MQTT_HOST, port, &hints, &result);
	if (rc != 0) {
		LOG_WRN("Broker DNS resolution failed: %d", rc);
		return -EHOSTUNREACH;
	}
	memcpy(&broker, result->ai_addr, result->ai_addrlen);
	zsock_freeaddrinfo(result);
	return 0;
}

static int connect_mqtt(void)
{
	/* 初始化新的 TLS MQTT client，并发起异步连接。 */
	struct mqtt_sec_config tls = { .peer_verify = 2, .hostname = CONFIG_APP_MQTT_HOST };
	static struct mqtt_utf8 client_id = MQTT_UTF8_LITERAL(CONFIG_APP_DEVICE_NAME);
	static struct mqtt_utf8 username = MQTT_UTF8_LITERAL(CONFIG_APP_MQTT_USERNAME);
	static struct mqtt_utf8 password = MQTT_UTF8_LITERAL(CONFIG_APP_MQTT_PASSWORD);

	if (resolve_broker() != 0) {
		return -EHOSTUNREACH;
	}
#ifndef APP_HAS_CA_CERT
	LOG_ERR("MQTTS CA certificate is not embedded");
	return -EINVAL;
#else
	if (tls_credential_add(APP_CA_CERT_TAG, TLS_CREDENTIAL_CA_CERTIFICATE,
			       ca_certificate, sizeof(ca_certificate)) != 0) {
		LOG_ERR("MQTTS CA credential registration failed");
		return -EIO;
	}
	tls.sec_tag_list = sec_tags;
	tls.sec_tag_count = 1;
#endif
	mqtt_client_init(&client);
	client.broker = &broker;
	client.evt_cb = mqtt_event;
	client.client_id = client_id;
	client.user_name = &username;
	client.password = &password;
	client.protocol_version = MQTT_VERSION_3_1_1;
	client.rx_buf = rx_buffer;
	client.rx_buf_size = sizeof(rx_buffer);
	client.tx_buf = tx_buffer;
	client.tx_buf_size = sizeof(tx_buffer);
	client.transport.type = MQTT_TRANSPORT_SECURE;
	client.transport.tls.config = tls;
	return mqtt_connect(&client);
}

static int publish(const struct outbound_message *message)
{
	/* 发布一条完整 protobuf 批次；仅在收到 PUBACK 后才确认发送成功。 */
	struct mqtt_publish_param param = { 0 };
	struct mqtt_topic mqtt_topic = {
		.topic = { .utf8 = (uint8_t *)topic, .size = strlen(topic) },
		.qos = MQTT_QOS_1_AT_LEAST_ONCE,
	};

	puback_received = false;
	param.message.topic = mqtt_topic;
	param.message.payload.data = (uint8_t *)message->data;
	param.message.payload.len = message->length;
	param.message_id = packet_id++;
	param.dup_flag = 0;
	param.retain_flag = 0;
	return mqtt_publish(&client, &param);
}

static void mqtt_thread(void)
{
	/* 在独立线程串行执行 DNS、连接、发布、PUBACK 与重连。 */
	struct outbound_message message;
	int backoff_s = 1;

	while (true) {
		k_sem_take(&network_changed, K_FOREVER);
		while (network_ready && IS_ENABLED(CONFIG_APP_MQTT_ENABLED)) {
			if (!connected) {
				if (connect_mqtt() != 0) {
					k_sleep(K_SECONDS(backoff_s));
					backoff_s = MIN(backoff_s * 2, 60);
					continue;
				}
				for (int i = 0; network_ready && i < 20 && !connected; ++i) {
					(void)mqtt_input(&client);
					k_sleep(K_MSEC(100));
				}
				if (!connected) {
					(void)mqtt_disconnect(&client, NULL);
					k_sleep(K_SECONDS(backoff_s));
					backoff_s = MIN(backoff_s * 2, 60);
					continue;
				}
				backoff_s = 1;
			}
			if (k_msgq_get(&outbound_queue, &message, K_SECONDS(1)) != 0) {
				continue;
			}
			if (publish(&message) != 0) {
				connected = false;
				(void)mqtt_uploader_enqueue(message.data, message.length);
				continue;
			}
			for (int i = 0; network_ready && i < 50 && !puback_received; ++i) {
				(void)mqtt_input(&client);
				k_sleep(K_MSEC(100));
			}
			if (!puback_received) {
				connected = false;
				(void)mqtt_uploader_enqueue(message.data, message.length);
			}
		}
		if (connected) {
			(void)mqtt_disconnect(&client, NULL);
			connected = false;
		}
	}
}

K_THREAD_DEFINE(mqtt_thread_id, 4096, mqtt_thread, NULL, NULL, NULL, 5, 0, 0);

void mqtt_uploader_init(void)
{
	/* 启动时一次性生成设备专属的 Raw protobuf topic。 */
	snprintk(topic, sizeof(topic), "/sys/%s/thing/model/up_raw", CONFIG_APP_DEVICE_NAME);
}

void mqtt_uploader_set_network_ready(bool ready)
{
	/* DHCP 就绪或 Wi-Fi 连通性变化时唤醒 MQTT 线程。 */
	network_ready = ready;
	k_sem_give(&network_changed);
}

int mqtt_uploader_enqueue(const uint8_t *data, size_t length)
{
	/* 队列只保存完整批次；满时丢弃最旧的易失批次。 */
	struct outbound_message message;
	struct outbound_message discarded;
	if (length > sizeof(message.data)) {
		return -EMSGSIZE;
	}
	message.length = length;
	memcpy(message.data, data, length);
	if (k_msgq_put(&outbound_queue, &message, K_NO_WAIT) == 0) {
		return 0;
	}
	(void)k_msgq_get(&outbound_queue, &discarded, K_NO_WAIT);
	return k_msgq_put(&outbound_queue, &message, K_NO_WAIT);
}
```

## src/network.c
```c
/* Wi-Fi 生命周期模块：只上报网络就绪状态，不直接操作 MQTT。 */
#include <string.h>

#include <zephyr/logging/log.h>
#include <zephyr/net/net_if.h>
#include <zephyr/net/net_mgmt.h>
#include <zephyr/net/wifi_mgmt.h>
#include <zephyr/sys/util.h>

#include "mqtt_uploader.h"
#include "network.h"

LOG_MODULE_REGISTER(network, LOG_LEVEL_INF);

static void wifi_event(struct net_mgmt_event_callback *cb, uint64_t event, struct net_if *iface)
{
	/* 仅在 DHCP 完成后，DNS 与 MQTT 才具备运行条件。 */
	ARG_UNUSED(cb);
	ARG_UNUSED(iface);
	if (event == NET_EVENT_IPV4_ADDR_ADD) {
		LOG_INF("Wi-Fi obtained IPv4 address");
		mqtt_uploader_set_network_ready(true);
	} else if (event == NET_EVENT_WIFI_DISCONNECT_RESULT) {
		LOG_WRN("Wi-Fi disconnected");
		mqtt_uploader_set_network_ready(false);
	}
}

static struct net_mgmt_event_callback wifi_events;

void network_start(void)
{
	/* 先注册事件，避免遗漏过早到达的 DHCP 事件。 */
	struct wifi_connect_req_params params = {
		.ssid = CONFIG_APP_WIFI_SSID,
		.ssid_length = strlen(CONFIG_APP_WIFI_SSID),
		.psk = CONFIG_APP_WIFI_PSK,
		.psk_length = strlen(CONFIG_APP_WIFI_PSK),
		.security = WIFI_SECURITY_TYPE_PSK,
		.channel = WIFI_CHANNEL_ANY,
	};

	net_mgmt_init_event_callback(&wifi_events, wifi_event,
		NET_EVENT_IPV4_ADDR_ADD | NET_EVENT_WIFI_DISCONNECT_RESULT);
	net_mgmt_add_event_callback(&wifi_events);

	if (!IS_ENABLED(CONFIG_APP_MQTT_ENABLED)) {
		return;
	}
	if (params.ssid_length == 0 || params.psk_length == 0) {
		LOG_WRN("MQTT enabled but Wi-Fi configuration is missing");
		return;
	}
	if (net_mgmt(NET_REQUEST_WIFI_CONNECT, net_if_get_default(), &params, sizeof(params)) != 0) {
		LOG_WRN("Wi-Fi connection request failed");
	}
}
```

## src/telemetry.c
```c
/* 为完整温度与 IMU 批次构造 protobuf 信封。 */
#include "telemetry.h"

#include <errno.h>
#include <string.h>
#include <zephyr/random/random.h>
#include <pb_encode.h>
#include "proto/telemetry.pb.h"

static uint32_t boot_id;
static uint32_t sequence;

static uint64_t next_message_id(void)
{
	/* 将每次启动的随机命名空间与单调递增序号组合为消息 ID。 */
	if (boot_id == 0U) {
		boot_id = sys_rand32_get();
		if (boot_id == 0U) {
			boot_id = 1U;
		}
	}
	return ((uint64_t)boot_id << 32) | ++sequence;
}

static int encode(starter_iot_telemetry_v1_PropertyPost *post, uint8_t *out, size_t out_size, size_t *encoded_size)
{
	/* 编码到调用方提供的固定缓冲区；不使用堆内存。 */
	pb_ostream_t stream = pb_ostream_from_buffer(out, out_size);

	if (!pb_encode(&stream, starter_iot_telemetry_v1_PropertyPost_fields, post)) {
		return -EMSGSIZE;
	}
	*encoded_size = stream.bytes_written;
	return 0;
}

int telemetry_encode_temperature(uint64_t time_ms, const int32_t values[], size_t count,
				 uint8_t *out, size_t out_size, size_t *encoded_size)
{
	/* 构造仅包含一个完整温度批次的 Raw PropertyPost。 */
	if (count != TELEMETRY_TEMPERATURE_SAMPLES) {
		return -EINVAL;
	}

	starter_iot_telemetry_v1_PropertyPost post = starter_iot_telemetry_v1_PropertyPost_init_zero;
	post.id = next_message_id();
	strcpy(post.version, "1.0");
	post.sys.ack = false;
	post.method = starter_iot_telemetry_v1_Method_PROPERTY_POST;
	post.params_count = 1;
	post.params[0].time_ms = time_ms;
	post.params[0].which_value = starter_iot_telemetry_v1_Property_cpu_temperature_tag;
	post.params[0].value.cpu_temperature.samples_count = count;
	for (size_t i = 0; i < count; ++i) {
		post.params[0].value.cpu_temperature.samples[i].value = values[i];
	}
	return encode(&post, out, out_size, encoded_size);
}

int telemetry_encode_imu(uint64_t time_ms, const struct telemetry_imu values[], size_t count,
			 uint8_t *out, size_t out_size, size_t *encoded_size)
{
	/* 构造仅包含一个完整 IMU 批次的 Raw PropertyPost。 */
	if (count != TELEMETRY_IMU_SAMPLES) {
		return -EINVAL;
	}

	starter_iot_telemetry_v1_PropertyPost post = starter_iot_telemetry_v1_PropertyPost_init_zero;
	post.id = next_message_id();
	strcpy(post.version, "1.0");
	post.sys.ack = false;
	post.method = starter_iot_telemetry_v1_Method_PROPERTY_POST;
	post.params_count = 1;
	post.params[0].time_ms = time_ms;
	post.params[0].which_value = starter_iot_telemetry_v1_Property_imu_tag;
	post.params[0].value.imu.samples_count = count;
	for (size_t i = 0; i < count; ++i) {
		starter_iot_telemetry_v1_Imu *sample = &post.params[0].value.imu.samples[i];
		sample->accel_x = values[i].accel_x;
		sample->accel_y = values[i].accel_y;
		sample->accel_z = values[i].accel_z;
		sample->gyro_x = values[i].gyro_x;
		sample->gyro_y = values[i].gyro_y;
		sample->gyro_z = values[i].gyro_z;
	}
	return encode(&post, out, out_size, encoded_size);
}
```

## src/time_service.c
```c
/* 基于 PCF8563 的 UTC 服务，以及首次串口校时命令。 */
#include "time_service.h"

#include <errno.h>
#include <time.h>
#include <zephyr/device.h>
#include <zephyr/drivers/rtc.h>
#include <zephyr/shell/shell.h>
#include <zephyr/sys/timeutil.h>

static const struct device *const rtc = DEVICE_DT_GET(DT_ALIAS(rtc));

bool time_service_get_ms(uint64_t *time_ms)
{
	/* RTC 不可用或未校时时返回 false，避免上传错误时间。 */
	struct rtc_time value;
	int64_t seconds;

	if (!device_is_ready(rtc) || rtc_get_time(rtc, &value) != 0 || value.tm_year < 125) {
		return false;
	}
	seconds = timeutil_timegm64(rtc_time_to_tm(&value));
	if (seconds < 0) {
		return false;
	}
	*time_ms = (uint64_t)seconds * 1000U + value.tm_nsec / 1000000U;
	return true;
}

int time_service_set_unix_seconds(int64_t seconds)
{
	/* 将 UTC Unix 秒转换为 RTC 驱动使用的日历格式。 */
	struct tm tm_value;
	struct rtc_time rtc_value = { 0 };
	time_t unix_time = (time_t)seconds;

	if (!device_is_ready(rtc) || gmtime_r(&unix_time, &tm_value) == NULL) {
		return -ENODEV;
	}
	rtc_value.tm_sec = tm_value.tm_sec;
	rtc_value.tm_min = tm_value.tm_min;
	rtc_value.tm_hour = tm_value.tm_hour;
	rtc_value.tm_mday = tm_value.tm_mday;
	rtc_value.tm_mon = tm_value.tm_mon;
	rtc_value.tm_year = tm_value.tm_year;
	rtc_value.tm_wday = tm_value.tm_wday;
	rtc_value.tm_yday = tm_value.tm_yday;
	rtc_value.tm_isdst = -1;
	return rtc_set_time(rtc, &rtc_value);
}

static int cmd_time_get(const struct shell *shell, size_t argc, char **argv)
{
	/* Shell 适配层：以 Unix 秒显示已校验的 RTC 时间。 */
	uint64_t ms;
	ARG_UNUSED(argc); ARG_UNUSED(argv);
	if (!time_service_get_ms(&ms)) {
		shell_error(shell, "RTC time is invalid; use: time set <unix_seconds>");
		return -EINVAL;
	}
	shell_print(shell, "%llu", ms / 1000U);
	return 0;
}

static int cmd_time_set(const struct shell *shell, size_t argc, char **argv)
{
	/* Shell 适配层：无 NTP 来源时手动设置 UTC。 */
	int err;
	int rtc_err;
	long parsed;
	int64_t seconds;
	parsed = shell_strtol(argc == 2 ? argv[1] : "", 10, &err);
	seconds = parsed;
	if (argc != 2 || err != 0) {
		shell_error(shell, "usage: time set <unix_seconds>");
		return -EINVAL;
	}
	rtc_err = time_service_set_unix_seconds(seconds);
	if (rtc_err != 0) {
		shell_error(shell, "RTC set failed: %d", rtc_err);
		return rtc_err;
	}
	shell_print(shell, "RTC set");
	return 0;
}

SHELL_STATIC_SUBCMD_SET_CREATE(time_cmds,
	SHELL_CMD(get, NULL, "Show UTC Unix seconds", cmd_time_get),
	SHELL_CMD(set, NULL, "Set UTC: time set <unix_seconds>", cmd_time_set),
	SHELL_SUBCMD_SET_END);
SHELL_CMD_REGISTER(time, &time_cmds, "PCF8563 UTC clock", NULL);
```

## src/wifi.c
```c
/* Wi-Fi 生命周期模块：DHCP 成功后通知 MQTT 上传器。 */
#include <string.h>

#include <zephyr/logging/log.h>
#include <zephyr/net/net_if.h>
#include <zephyr/net/net_mgmt.h>
#include <zephyr/net/wifi_mgmt.h>
#include <zephyr/sys/util.h>

#include "mqtt_uploader.h"
#include "wifi.h"

LOG_MODULE_REGISTER(wifi, LOG_LEVEL_INF);

static void wifi_event(struct net_mgmt_event_callback *cb, uint64_t event, struct net_if *iface)
{
	ARG_UNUSED(cb);
	ARG_UNUSED(iface);
	if (event == NET_EVENT_IPV4_ADDR_ADD) {
		LOG_INF("Wi-Fi obtained IPv4 address");
		mqtt_uploader_set_network_ready(true);
	} else if (event == NET_EVENT_WIFI_DISCONNECT_RESULT) {
		LOG_WRN("Wi-Fi disconnected");
		mqtt_uploader_set_network_ready(false);
	}
}

static struct net_mgmt_event_callback wifi_events;

void wifi_start(void)
{
	struct wifi_connect_req_params params = {
		.ssid = CONFIG_APP_WIFI_SSID,
		.ssid_length = strlen(CONFIG_APP_WIFI_SSID),
		.psk = CONFIG_APP_WIFI_PSK,
		.psk_length = strlen(CONFIG_APP_WIFI_PSK),
		.security = WIFI_SECURITY_TYPE_PSK,
		.channel = WIFI_CHANNEL_ANY,
	};

	net_mgmt_init_event_callback(&wifi_events, wifi_event,
		NET_EVENT_IPV4_ADDR_ADD | NET_EVENT_WIFI_DISCONNECT_RESULT);
	net_mgmt_add_event_callback(&wifi_events);
	if (!IS_ENABLED(CONFIG_APP_MQTT_ENABLED)) {
		return;
	}
	if (params.ssid_length == 0 || params.psk_length == 0) {
		LOG_WRN("MQTT enabled but Wi-Fi configuration is missing");
		return;
	}
	if (net_mgmt(NET_REQUEST_WIFI_CONNECT, net_if_get_default(), &params, sizeof(params)) != 0) {
		LOG_WRN("Wi-Fi connection request failed");
	}
}
```
